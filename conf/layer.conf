## conf/layer.conf
```bitbake
# We have a conf and classes directory, add to BBPATH
BBPATH := "${BBPATH}:${LAYERDIR}"
# We have a packages directory, add to BBFILES
BBFILES := "${BBFILES} ${LAYERDIR}/recipes-*/*.bb \ 
           ${LAYERDIR}/recipes-*/*.bbappend"

BBFILE_COLLECTIONS += "booma"
BBFILE_PATTERN_booma := "^${LAYERDIR}/"
BBFILE_PRIORITY_booma := "5"

LAYERDEPENDS_booma = "sota"
LAYERDEPENDS_booma += "raspberrypi"
LAYERSERIES_COMPAT_booma = "thud"
```
